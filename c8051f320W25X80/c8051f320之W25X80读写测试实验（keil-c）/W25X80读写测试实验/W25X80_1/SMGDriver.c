//---------------------------------------------------------------------------------
//
//								  数码管驱动程序（.C）
//									
//																
//						 	  作者：赌神    2011年2月25日
//---------------------------------------------------------------------------------

#include <C8051F320.H>

//=================================================================================
//                                   数码管预定义
//=================================================================================

//数码管控制接口定义
sbit SMG1_SELECT  =  P2^0;  //第一位数码管控制位
sbit SMG2_SELECT  =  P2^1;  //第二位数码管控制位
sbit SMG3_SELECT  =  P2^2;  //第三位数码管控制位
sbit SMG4_SELECT  =  P2^3;  //第四位数码管控制位

//595的控制接口定义
sbit SPI_STCP   =   P2^4;		
sbit SPI_SHCP   =   P1^3;		
sbit SPI_DS		=   P1^2;

//常量定义
unsigned char code shuzi[]={0xc0,0xf9,0xa4,0xb0,0x99,0x92,0x82,0xf8,
                      0x80,0x90,0x88,0x83,0xc6,0xa1,0x86,0x8e};

//------------------------------------------------------------------------------------------
//=================================================================================
//                                   内部函数定义
//=================================================================================
//---------------------------------------------------
//函数功能：向595传输要显示的数据
//---------------------------------------------------
static void txData(unsigned char dat)
{
	unsigned char i;
    SPI_STCP=0;
    for(i=0;i<8;i++)
    {
		SPI_SHCP=0;
		if (dat &0x80) 
			SPI_DS=1;
		else 
			SPI_DS=0;
		dat <<= 1;
		SPI_SHCP=1;
    }
    SPI_STCP=1;
}
//------------------------------------------------------------------------------------------
//=================================================================================
//                                   接口函数定义
//=================================================================================
//---------------------------------------------------
//函数功能：配置交叉开关，设置输入输出方式
//---------------------------------------------------    
void SMG_Port_Init()
{                   
	P2MDOUT |= 0x1F;
	P1MDOUT |= 0x0E;                   
    XBR0	= 0x00;						    
	XBR1	= 0x40;
	P2 &= 0xF0;
	P1 &= 0xFD;					 
}
//---------------------------------------------------
//select的低四位控制数码管位选，为1则选中。data是要显示的数值，范围：0-F
//返回值为0操作失败，其他操作成功
//---------------------------------------------------
unsigned char lightSMG(unsigned char select,unsigned char dat)
{
	SMG1_SELECT=0;
	SMG2_SELECT=0;
	SMG3_SELECT=0;
	SMG4_SELECT=0;
	if(select & 0x01)
		SMG1_SELECT=1;
	if(select & 0x02)
		SMG2_SELECT=1;
	if(select & 0x04)
		SMG3_SELECT=1;
	if(select & 0x08)
		SMG4_SELECT=1;
	txData(shuzi[dat]);
	return 1;
}
//------------------------------------------------------------------------------------------